/***************************************************************************************
  * 鏈▼搴忕敱b绔欒妺澶撮洦-鍒涘缓骞跺厤璐瑰紑婧愬叡浜?
  * 浣犲彲浠ヤ换鎰忔煡鐪嬨€佷娇鐢ㄥ拰淇敼锛屽苟搴旂敤鍒拌嚜宸辩殑椤圭洰涔嬩腑
  * 绋嬪簭鐗堟潈褰掓睙鍗忕鎶€鎵€鏈夛紝浠讳綍浜烘垨缁勭粐涓嶅緱灏嗗叾鎹负宸辨湁
  ***************************************************************************************
  */
#include "myfile.h"
volatile uint8_t data_ready = 0;

/************************涓诲嚱鏁?**************************/
int main(void)
{
		MPU6050_Init();
		OLED_Init();
		Encoder_Init(); 
		SENSOR_GPIO_Config(); //寰抗寮曡剼鍒濆鍖?
		Motor_Init();					//鐢垫満鍒濆鍖?
		PWM_Init();						//鍗犵┖姣斿畾鏃跺櫒1鍒濆鍖?
		Timer_Init();					//所有外设就绪后再开启控制中断
	
	while (1)
	{		  
		if(data_ready) 	//灏嗛檧铻轰华鏀惧埌涓诲惊鐜繍琛岋紝閬垮厤杩囦簬棰戠箒瀵艰嚧鐨勪腑鏂崱椤匡紙绠楀姏涓嶅锛?
					{  	 
						//鑾峰彇闄€铻轰华
						MPU6050_GetData(&AX, &AY, &AZ, &GX, &GY,&GZ);		
						data_ready = 0;
          }			
			menu_operation();																					//鑿滃崟璋冪敤鍑芥暟
			OLED_Update();	
	}
}
/************************涓柇***************************/
void TIM4_IRQHandler(void)
{

	if (TIM_GetITStatus(TIM4, TIM_IT_Update) == SET)
	{			
		Control();      //鎺у埗鍑芥暟锛堟渶涓昏鐨勬帶鍒堕兘鍦ㄨ繖閲岄潰锛?
		data_ready = 1; //闄€铻轰华鎺у埗鏍囧織浣?
		TIM_ClearITPendingBit(TIM4, TIM_IT_Update);
	}
}







